

#ifndef EPD_BASE_H
#define EPD_BASE_H

#include "epdif.h"

#define UWORD   unsigned int
#define UBYTE   unsigned char
#define UDOUBLE unsigned long

// Longest any single BUSY wait may take before the frame is abandoned (see Epd::WaitWhileBusy).
// A full refresh of the slowest supported panel (7.3" ACeP) takes about 35 s; drivers may raise it.
#ifndef EPD_BUSY_TIMEOUT_MS
#define EPD_BUSY_TIMEOUT_MS 45000UL
#endif

// Fast refresh: redraw only the pixels that change, without the full-screen black/white flash. Set
// EPD_FAST_REFRESH true in display_config.h; the WiFi sketches then use it on timer wakes. Panels whose
// driver is not listed in EPD_HAS_FAST_REFRESH ignore the flag.
#ifndef EPD_FAST_REFRESH
#define EPD_FAST_REFRESH false
#endif
#if defined(EPD2IN9_C)
#define EPD_HAS_FAST_REFRESH 1
#else
#define EPD_HAS_FAST_REFRESH 0
#endif
#define EPD_USE_FAST_REFRESH (EPD_FAST_REFRESH && EPD_HAS_FAST_REFRESH)
// Fast refreshes between two full ones. Partial refreshes leave a faint ghost that a full one clears.
#ifndef EPD_FULL_REFRESH_EVERY
#define EPD_FULL_REFRESH_EVERY 60
#endif

// Compile-time check every driver places next to its EPD_BLOCK_SIZE: one cloud .bin plane must be
// exactly planeWidth x planeHeight pixels at the driver's stream bits per pixel.
#define EPD_CHECK_PLANE(planeWidth, planeHeight, bitsPerPixel, blockSize) \
    static_assert((unsigned long)(blockSize) * 8UL == (unsigned long)(planeWidth) * (unsigned long)(planeHeight) * (unsigned long)(bitsPerPixel), \
                  "EPD_BLOCK_SIZE does not match the plane geometry and bits per pixel")

#define QRDIM 32
const uint8_t wifi_qrcode_32x32_data[] = {
    0x00, 0x00, 0x00, 0x00, 0x7F, 0x4F, 0x09, 0xFC, 0x41, 0x31, 0x2D, 0x04,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 0x00
};

const unsigned int wifi_qrcode_32x32_size = 128;

// // Image size: 64x64 pixels
// const uint8_t wifi_qrcode_64x64_data[] = {
//     0xFF, 0xFE, 0x30, 0xFF, 0x80, 0x30, 0x7F, 0xFF, 0xFF, 0xFE, 0x30, 0xFF, 0x80,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 0xF0
// };
// const unsigned int wifi_qrcode6_64x64_size = 512;

class Epd : EpdIf {
public:
    unsigned long width;
    unsigned long height;
    unsigned char steps;
    unsigned char stepCommands[4];
    // Per step: complement every byte of that cloud .bin plane before it reaches the panel. Each driver sets
    // this explicitly from the Builder code it displays (screenCode) and the polarity of its RAM; see the
    // polarity table in CLAUDE.md. Never a global rule: the Builder codes do not share one polarity.
    bool stepInvert[4] = {false, false, false, false};
    unsigned long blockSize;
    // Builder screen-type base code this driver displays ("A", "AR", "AS", "V2A", "B", "BR", "G", "GR", "F").
    // Used by QRset (stream polarity) and by the sketch to reject a .bin made for another panel.
    const char* screenCode = nullptr;
    Epd();
    ~Epd();
    int  Init(void);
    void WaitUntilIdle(void);
    void Reset(void);
    void SetLut(void);
    void SetPartialLut(void);   // only drivers listed in EPD_HAS_FAST_REFRESH define it
     void SetLut_by_host(unsigned char *lut_vcom, unsigned char *lut_ww, unsigned char *lut_bw, unsigned char *lut_wb, unsigned char *lut_bb);
    void SendCommand(unsigned char command);
    void SetToDataMode();
    void SendData(unsigned char data);
    void SendDataFast(unsigned char data);
    void Sleep(void);
    void ClearFrame(void);
    void Clear(unsigned char color);
    void TurnOnDisplay(void);
    void QRset(int scale);
    uint8_t get_bit(const uint8_t *array, size_t bit_position);
    void SetFrameStart(char mode, unsigned char command);
    void SendBuffer(unsigned char* buffer, int size);
    bool ShowDebug;

    // One byte of cloud .bin plane `step` (data mode already selected): apply the driver's polarity for that
    // step and clock it out. The download loop, the serial bridge and QRset all go through here.
    void SendStreamByte(unsigned char value, int step) {
        if (stepInvert[step & 3]) value = (unsigned char)~value;
        if (expand_1bpp_to_4bpp) {
            // 7.5" V1 (UC8159): its RAM holds 4 bits per pixel; stream bit 1 = black (0x0), 0 = white (0x3).
            for (int bit = 7; bit > 0; bit -= 2) {
                unsigned char hi = (value >> bit) & 1 ? 0x0 : 0x3;
                unsigned char lo = (value >> (bit - 1)) & 1 ? 0x0 : 0x3;
                SendDataFast((unsigned char)((hi << 4) | lo));
            }
            return;
        }
        SendDataFast(value);
    }
    // Draws a whole cloud frame held in memory (steps x blockSize bytes) and returns false on a BUSY timeout.
    // fast: partial waveform, no flash; the panel RAM must hold the picture on screen. The controller swaps
    // between two RAM banks on every refresh, so a fast-capable panel gets the frame written once more:
    // both banks then hold this picture, which the next fast refresh compares against.
    bool ShowFrame(const uint8_t* frame, bool fast) {
#if EPD_HAS_FAST_REFRESH
        if (fast) SetPartialLut(); else SetLut();
#endif
        WriteFrame(frame);
        TurnOnDisplay();
        if (busy_timed_out) return false;
#if EPD_HAS_FAST_REFRESH
        WriteFrame(frame);
#endif
        return true;
    }
    // True once any BUSY wait has timed out since boot. Later waits return at once so the caller can
    // abandon the frame and sleep instead of hanging with the radio on.
    bool BusyTimedOut() const { return busy_timed_out; }
    void ClearBusyTimeout() { busy_timed_out = false; }   // the serial bridge retries after a re-Init
    // Every driver must set these; a zero here means a driver forgot (QRset and the sketches refuse to stream).
    bool PixelFormatValid() const {
        return (bits_per_pixel == 1 || bits_per_pixel == 2 || bits_per_pixel == 4) && pixels_per_byte * bits_per_pixel == 8
            && steps >= 1 && steps <= 4 && height > 0 && blockSize > 0 && blockSize % height == 0 && screenCode != nullptr;
    }
    unsigned char BitsPerPixel() const { return bits_per_pixel; }
private:
    unsigned int reset_pin;
    unsigned int dc_pin;
    unsigned int cs_pin;
    unsigned int busy_pin;
    unsigned char bits_per_pixel = 0;   // bits per pixel of the cloud stream (and of the panel RAM, except the 7.5" V1)
    unsigned char pixels_per_byte = 0;
    bool expand_1bpp_to_4bpp = false;
    unsigned long busy_timeout_ms = EPD_BUSY_TIMEOUT_MS;
    bool busy_timed_out = false;

    void WriteFrame(const uint8_t* frame) {
        for (int step = 0; step < steps; ++step) {
            SendCommand(stepCommands[step]);
            SetToDataMode();
            const uint8_t* plane = frame + (unsigned long)step * blockSize;
            for (unsigned long i = 0; i < blockSize; ++i) SendStreamByte(plane[i], step);
        }
    }

    // Bounded BUSY wait shared by every driver: waits while the BUSY pin reads busyLevel. The pin is pulled
    // toward the released level, so a missing panel or open FPC ends the wait instead of floating.
    // pollCommand >= 0 is sent before each read (UC8179 "get status" 0x71). Returns false on timeout.
    bool WaitWhileBusy(int busyLevel, unsigned int pollMs, int pollCommand = -1) {
        if (busy_timed_out) return false;
        pinMode(busy_pin, busyLevel == HIGH ? INPUT_PULLDOWN : INPUT_PULLUP);
        unsigned long started = millis();
        for (;;) {
            if (pollCommand >= 0) SendCommand((unsigned char)pollCommand);
            if (DigitalRead(busy_pin) != busyLevel) return true;
            if (millis() - started >= busy_timeout_ms) {
                busy_timed_out = true;
                Serial.println("ERROR busy-timeout: the panel did not release BUSY (check the carrier board BUSY pin and the FPC)");
                return false;
            }
            DelayMs(pollMs > 0 ? pollMs : 1);
        }
    }
};

#endif /* EPD_BASE_H */

/* END OF FILE */
